## config/boards/shields/Lotus65/Kconfig.board
```kconfig
# Lotus65 board configuration

# Copyright (c) 2020 The ZMK Contributors
# SPDX-License-Identifier: MIT

config BOARD_LOTUS65
	bool "Lotus65 Keyboard"
	depends on SOC_NRF52840_QIAA
```
